/* Merge only if the generated device tree does not already enable GEM0. */
&gem0 {
    status = "okay";
    phy-mode = "mii";
    phy-handle = <&phy0>;

    mdio {
        #address-cells = <1>;
        #size-cells = <0>;
        phy0: ethernet-phy@0 {
            reg = <0>;
        };
    };
};
